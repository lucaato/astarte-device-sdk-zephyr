## Kconfig
```
# (C) Copyright 2024, SECO Mind Srl
#
# SPDX-License-Identifier: Apache-2.0
#
# This file is the application Kconfig entry point. All application Kconfig
# options can be defined here or included via other application Kconfig files.
# You can browse these options using the west targets menuconfig (terminal) or
# guiconfig (GUI).

menu "Zephyr"
source "Kconfig.zephyr"
endmenu

rsource "../Kconfig"

menu "E2E test"

config TLS_CERTIFICATE_PATH
	string "Path of the tls certificate"
	help
	  Path to a certificate in PEM format. it will be included in the binary and used for TLS
	  authentication.
	  This path should be relative to the end to end project folder.

config DEVICE_ID
	string "Astarte device ID"
    default ""
	help
	  Device ID to be used to connect to Astarte.

config CREDENTIAL_SECRET
    string "Astarte credential secret"
    default ""
    help
        The credential secret to be used to connect to Astarte.

config E2E_APPENGINE_TOKEN
	string "Token to access appengine APIs"
    default ""
	help
	  Token used to access the Astarte appengine APIs.

config E2E_APPENGINE_URL
    string "Url of the appengine APIs"
    default ""
    help
        Url of the appengine APIs exposed by astarte

config LOG_ONLY
    bool "Enable device log only mode"
    default n
    help
        Incoming astarte server messages will only be logged and no check will be
        performed against incoming data

config DEVICE_THREAD_STACK_SIZE
    int "Device thread stack size (Bytes)"
    default 8192
    help
        Use this setting to change the size of the stack for the thread running the Astarte device.

config DEVICE_THREAD_PRIORITY
    int "Device thread priority"
    default 0
    help
        Use this setting to change the priority of the thread running the Astarte device.

config DEVICE_POLL_PERIOD_MS
    int "Device thread polling period (ms)"
    default 100
    help
        Use this setting to change the polling period for the Astarte device.

config ETH_POLL_PERIOD_MS
    int "Device thread polling period (ms)"
    default 100
    help
        Use this setting to change the polling period for the ethernet connection.

config MQTT_CONNECTION_TIMEOUT_MS
    int "MQTT connection timeout (ms)"
    default 3000
    help
        Use this setting to change the MQTT connection timeout.

config MQTT_POLL_TIMEOUT_MS
    int "MQTT subsequent polling timeout (ms)"
    default 200
    help
        Use this setting to change the MQTT polling timeout.

config HTTP_TIMEOUT_MS
    int "HTTP operations timeout (ms)"
    default 3000
    help
        Use this setting to change the timeout for HTTP requests.

menu "Logging options"

module = APP
module-str = APP
source "subsys/logging/Kconfig.template.log_config"

module = RUNNER
module-str = Log level for e2e runner and command handler
module-help = Sets log level for e2e runner and command handler
source "subsys/logging/Kconfig.template.log_config"

module = IDATA
module-str = Log level for e2e idata functions
module-help = Sets log level for e2e idata functions
source "subsys/logging/Kconfig.template.log_config"

module = UTILITIES
module-str = Log level for e2e utilities functions
module-help = Sets log level for e2e utilities functions
source "subsys/logging/Kconfig.template.log_config"

module = SHELL_HANDLERS
module-str = Log level for shell handlers
module-help = Sets log level for zephyr shell handlers
source "subsys/logging/Kconfig.template.log_config"

module = DEVICE_HANDLER
module-str = Log level for device handler
module-help = Sets log level for zephyr device handler
source "subsys/logging/Kconfig.template.log_config"

endmenu

endmenu
```

## prj.conf
```kconfig
# (C) Copyright 2024, SECO Mind Srl
#
# SPDX-License-Identifier: Apache-2.0
#
# This is a Kconfig fragment which can be used to enable debug-related options
# in the application. See the README for more details.

CONFIG_NATIVE_UART_0_ON_STDINOUT=y
CONFIG_LOG_BACKEND_NATIVE_POSIX=n
CONFIG_SHELL=y
CONFIG_SHELL_BACKEND_SERIAL=y
CONFIG_SHELL_BACKEND_SERIAL_LOG_LEVEL_DBG=y
# FIXME uncomment to avoid inserting newlines at this length and use the dut exec_command
#CONFIG_SHELL_DEFAULT_TERMINAL_WIDTH=8192
CONFIG_SHELL_BACKEND_SERIAL_RX_RING_BUFFER_SIZE=8192
CONFIG_SHELL_CMD_BUFF_SIZE=8192

CONFIG_TLS_CERTIFICATE_PATH="certificate/api-eu1-astarte-cloud.pem"

CONFIG_DEBUG_OPTIMIZATIONS=y
CONFIG_MBEDTLS_DEBUG=y

# Enables debug logging
CONFIG_APP_LOG_LEVEL_DBG=y
CONFIG_RUNNER_LOG_LEVEL_DBG=y
CONFIG_UTILITIES_LOG_LEVEL_DBG=y
CONFIG_IDATA_LOG_LEVEL_DBG=y

# Astarte device SDK
CONFIG_ASTARTE_DEVICE_SDK=y
# The two certificate tags are the same as the root CA is the same for Astarte API and MQTT broker.
CONFIG_ASTARTE_DEVICE_SDK_HTTPS_CA_CERT_TAG=1
CONFIG_ASTARTE_DEVICE_SDK_MQTTS_CA_CERT_TAG=1
CONFIG_ASTARTE_DEVICE_SDK_CLIENT_CERT_TAG=2
# Enable sdk code generation
CONFIG_ASTARTE_DEVICE_SDK_ADVANCED_CODE_GENERATION=y
CONFIG_ASTARTE_DEVICE_SDK_ADVANCED_CODE_GENERATION_INTERFACE_DIRECTORY="interfaces/"
# Logging
CONFIG_ASTARTE_DEVICE_SDK_PAIRING_LOG_LEVEL_DBG=y
CONFIG_ASTARTE_DEVICE_SDK_CRYPTO_LOG_LEVEL_DBG=y
CONFIG_ASTARTE_DEVICE_SDK_HTTP_LOG_LEVEL_DBG=y
CONFIG_ASTARTE_DEVICE_SDK_DATA_LOG_LEVEL_DBG=y
CONFIG_ASTARTE_DEVICE_SDK_UUID_LOG_LEVEL_DBG=y
CONFIG_ASTARTE_DEVICE_SDK_BSON_LOG_LEVEL_DBG=y
CONFIG_ASTARTE_DEVICE_SDK_INTROSPECTION_LOG_LEVEL_DBG=y
CONFIG_ASTARTE_DEVICE_SDK_OBJECT_LOG_LEVEL_DBG=y
CONFIG_ASTARTE_DEVICE_SDK_MAPPING_LOG_LEVEL_DBG=y
CONFIG_ASTARTE_DEVICE_SDK_MQTT_LOG_LEVEL_DBG=y

# Enable logging with floating point support
CONFIG_LOG=y
CONFIG_CBPRINTF_FP_SUPPORT=y

# Increased stack size
CONFIG_MAIN_STACK_SIZE=16384

# Enable base64 encoding and decoding
CONFIG_BASE64=y

# Enable system hashmaps
CONFIG_SYS_HASH_MAP=y

# Enable JSON library
CONFIG_JSON_LIBRARY=y

# Enable entropy generator
CONFIG_ENTROPY_GENERATOR=y

# DNS resolver
CONFIG_DNS_RESOLVER=y
CONFIG_DNS_SERVER_IP_ADDRESSES=y
CONFIG_DNS_SERVER1="8.8.8.8" # Google DNS

# MbedTLS
CONFIG_MBEDTLS=y
CONFIG_MBEDTLS_BUILTIN=y
CONFIG_MBEDTLS_ENABLE_HEAP=y
CONFIG_MBEDTLS_HEAP_SIZE=55000
CONFIG_MBEDTLS_SSL_MAX_CONTENT_LEN=16384
CONFIG_MBEDTLS_PEM_CERTIFICATE_FORMAT=y
CONFIG_MBEDTLS_PK_WRITE_C=y # Required for PEM writing
CONFIG_MBEDTLS_ENTROPY_C=y
CONFIG_MBEDTLS_ENTROPY_POLL_ZEPHYR=y
CONFIG_MBEDTLS_TLS_VERSION_1_2=y
CONFIG_MBEDTLS_CIPHER=y
CONFIG_MBEDTLS_CIPHER_ALL_ENABLED=y
CONFIG_MBEDTLS_SERVER_NAME_INDICATION=y
CONFIG_MBEDTLS_KEY_EXCHANGE_ALL_ENABLED=y
CONFIG_MBEDTLS_HASH_ALL_ENABLED=y
CONFIG_MBEDTLS_CTR_DRBG_ENABLED=y
CONFIG_MBEDTLS_HMAC_DRBG_ENABLED=y
CONFIG_MBEDTLS_CHACHAPOLY_AEAD_ENABLED=y
CONFIG_MBEDTLS_ECDH_C=y
CONFIG_MBEDTLS_ECDSA_C=y
CONFIG_MBEDTLS_ECJPAKE_C=y
CONFIG_MBEDTLS_ECP_C=y
CONFIG_MBEDTLS_ECP_ALL_ENABLED=y
CONFIG_MBEDTLS_GENPRIME_ENABLED=y
CONFIG_MBEDTLS_PKCS5_C=y
CONFIG_MBEDTLS_X509_CRL_PARSE_C=y
CONFIG_MBEDTLS_X509_CSR_PARSE_C=y
CONFIG_MBEDTLS_X509_CSR_WRITE_C=y

# Enable networking
CONFIG_NETWORKING=y

# Sockets
CONFIG_NET_SOCKETS=y
CONFIG_NET_SOCKETS_POLL_MAX=4
CONFIG_NET_SOCKETS_SOCKOPT_TLS=y

# Use DHCP for IPv4 and IPv6
CONFIG_NET_DHCPV4=y
CONFIG_NET_DHCPV6=y

# Generic networking options
CONFIG_NET_TX_STACK_SIZE=2048
CONFIG_NET_RX_STACK_SIZE=2048
CONFIG_NET_PKT_RX_COUNT=10
CONFIG_NET_PKT_TX_COUNT=10
CONFIG_NET_BUF_RX_COUNT=20
CONFIG_NET_BUF_TX_COUNT=20
CONFIG_NET_MAX_CONTEXTS=10
CONFIG_NET_MGMT=y
CONFIG_NET_MGMT_EVENT=y
CONFIG_NET_IPV4=y
CONFIG_NET_IPV6=y
CONFIG_NET_TCP=y

# Enable HTTP client
CONFIG_HTTP_CLIENT=y

# MQTT options
CONFIG_MQTT_LIB=y
CONFIG_MQTT_LIB_TLS=y
CONFIG_MQTT_KEEPALIVE=60

# Enable flash
CONFIG_FLASH=y
CONFIG_FLASH_MAP=y
CONFIG_FLASH_PAGE_LAYOUT=y

# Enable NVS
CONFIG_NVS=y
CONFIG_NVS_LOG_LEVEL_WRN=y
```

## src/main.c
```c
/*
 * (C) Copyright 2024, SECO Mind Srl
 *
 * SPDX-License-Identifier: Apache-2.0
 */

#include <stdlib.h>

#include <zephyr/kernel.h>
#include <zephyr/logging/log.h>
#include <zephyr/sys/atomic.h>
#include <zephyr/sys/util.h>
#include <zephyr/sys_clock.h>

#if defined(CONFIG_ARCH_POSIX)
#include <nsi_main.h>
#endif

#include <astarte_device_sdk/device_id.h>
#include <astarte_device_sdk/pairing.h>

#if (!defined(CONFIG_ASTARTE_DEVICE_SDK_DEVELOP_USE_NON_TLS_HTTP)                                  \
    || !defined(CONFIG_ASTARTE_DEVICE_SDK_DEVELOP_USE_NON_TLS_MQTT))
/**
 * \def MBEDTLS_DEBUG_C
 *
 * Enable mbed tls debug
 */
#define MBEDTLS_DEBUG_C

#if defined(CONFIG_TLS_CERTIFICATE_PATH)
#include "ca_certificate_inc.h"
#endif

#include <mbedtls/debug.h>
#include <zephyr/net/tls_credentials.h>
#endif

#include "eth.h"

#include "runner.h"
#include "utilities.h"

LOG_MODULE_REGISTER(main, CONFIG_APP_LOG_LEVEL); // NOLINT

/************************************************
 *       Checks over configuration values       *
 ***********************************************/

BUILD_ASSERT(CONFIG_ARCH_POSIX == 1, "The e2e test needs to run on the native_sim board");
BUILD_ASSERT(
    sizeof(CONFIG_DEVICE_ID) == ASTARTE_DEVICE_ID_LEN + 1, "Missing device ID in e2e tets");
BUILD_ASSERT(sizeof(CONFIG_CREDENTIAL_SECRET) == ASTARTE_PAIRING_CRED_SECR_LEN + 1,
    "Missing credential secret in e2e test");

/************************************************
 * Constants, static variables and defines
 ***********************************************/

K_THREAD_STACK_DEFINE(eth_thread_stack_area, 1024);
static struct k_thread eth_thread_data;

enum e2e_thread_flags
{
    ETH_THREAD_TERMINATION_FLAG = 0,
};
static atomic_t device_thread_flags;

/************************************************
 * Static functions declaration
 ***********************************************/

static void eth_thread_entry_point(void *unused1, void *unused2, void *unused3);

/************************************************
 * Global functions definition
 ***********************************************/

int main(void)
{
    block_shell_commands();

    LOG_INF("Astarte device e2e test"); // NOLINT

    // Initialize Ethernet driver
    LOG_INF("Initializing Ethernet driver."); // NOLINT
    if (eth_connect() != 0) {
        LOG_ERR("Connectivity intialization failed!"); // NOLINT
        return -1;
    }

#if !(defined(CONFIG_ASTARTE_DEVICE_SDK_DEVELOP_USE_NON_TLS_HTTP)                                  \
    || defined(CONFIG_ASTARTE_DEVICE_SDK_DEVELOP_USE_NON_TLS_MQTT))

#if !defined(CONFIG_TLS_CERTIFICATE_PATH)
#error TLS is enabled but no generated certificate was found: check the CONFIG_TLS_CERTIFICATE_PATH option
#endif

    // Add TLS certificate
    tls_credential_add(CONFIG_ASTARTE_DEVICE_SDK_HTTPS_CA_CERT_TAG, TLS_CREDENTIAL_CA_CERTIFICATE,
        ca_certificate_root, ARRAY_SIZE(ca_certificate_root));

    // enable mbedtls logging
    mbedtls_debug_set_threshold(1);
#endif

    LOG_INF("Spawning a new thread to poll the eth interface and check connectivity."); // NOLINT
    k_thread_create(&eth_thread_data, eth_thread_stack_area,
        K_THREAD_STACK_SIZEOF(eth_thread_stack_area), eth_thread_entry_point, NULL, NULL, NULL,
        CONFIG_DEVICE_THREAD_PRIORITY, 0, K_NO_WAIT);

    LOG_INF("Running e2e test."); // NOLINT
    run_e2e_test();

    atomic_set_bit(&device_thread_flags, ETH_THREAD_TERMINATION_FLAG);
    CHECK_HALT(k_thread_join(&eth_thread_data, K_FOREVER) != 0,
        "Failed while waiting for the eth polling thread to terminate.");

    LOG_INF("Returning from the e2e test."); // NOLINT

    // we know we are running on POSIX because it is checked at build time (view BUILD_ASSERT)
    nsi_exit(0);
    return 0;
}

static void eth_thread_entry_point(void *unused1, void *unused2, void *unused3)
{
    ARG_UNUSED(unused1);
    ARG_UNUSED(unused2);
    ARG_UNUSED(unused3);

    LOG_INF("Starting eth polling thread"); // NOLINT

    while (!atomic_test_bit(&device_thread_flags, ETH_THREAD_TERMINATION_FLAG)) {
        k_timepoint_t timepoint = sys_timepoint_calc(K_MSEC(CONFIG_ETH_POLL_PERIOD_MS));

        eth_poll();

        k_sleep(sys_timepoint_timeout(timepoint));
    }
}
```

## include/device_handler.h
```c
/*
 * (C) Copyright 2025, SECO Mind Srl
 *
 * SPDX-License-Identifier: Apache-2.0
 */

#ifndef E2EDEVICE_HANDLERS_H
#define E2EDEVICE_HANDLERS_H

/**
 * @file device_handler.h
 * @brief Handle device object and threads, these function should be called by one thread only
 */

#include <astarte_device_sdk/device.h>

// Used only as a token to avoid
typedef void *test_device_handle_t;

void device_setup(astarte_device_config_t config);
astarte_device_handle_t get_device();
// these functions read device_thread_flags and wait appropriately
// flag DEVICE_CONNECTED
void wait_for_connection();
void wait_for_disconnection();
// these functions write device_thread_flags
// flag THREAD_TERMINATION
void set_termination();
void free_device();
// --

#endif /* E2ESHELL_HANDLERS_H */
```

## include/idata.h
```c
/*
 * (C) Copyright 2024, SECO Mind Srl
 *
 * SPDX-License-Identifier: Apache-2.0
 */

#ifndef IDATA_H
#define IDATA_H

/**
 * @file idata.h
 * @brief Interface data (idata) stored in the e2e test to perform checks
 */

#include <zephyr/sys/dlist.h>
#include <zephyr/sys/hash_map.h>
#include <zephyr/sys/spsc_lockfree.h>

#include <astarte_device_sdk/data.h>
#include <astarte_device_sdk/interface.h>
#include <astarte_device_sdk/object.h>

#include "utilities.h"

// Individual data used to store expected values from astarte
typedef struct
{
    const char *path;
    astarte_data_t data;
    idata_timestamp_option_t timestamp;
} idata_individual_t;

// Property data used to store expected values from astarte
// if unset is true the data element will contain an invalid value
typedef struct
{
    const char *path;
    astarte_data_t data;
    bool unset;
} idata_property_t;

// Object data used to store expected values from astarte
typedef struct
{
    const char *path;
    idata_object_entry_array entries;
    idata_byte_array object_bytes;
    idata_timestamp_option_t timestamp;
} idata_object_t;

typedef union
{
    idata_property_t property;
    idata_individual_t individual;
    idata_object_t object;
} idata_message_t;

// TODO replace struct definition with with SPSC_DECLARE once they remove the static
struct spsc_astarte_messages
{
    struct spsc _spsc;
    idata_message_t *const buffer;
};

typedef struct
{
    const astarte_interface_t *interface;
    // order of reception is enforced it is advisable to test one message at a time
    // since only two messages will be stored in the buffer
    // for example you should expect only one element of an individual interface
    struct spsc_astarte_messages messages;
    idata_message_t messages_buf[2];
} idata_map_value_t;

/**
 * Function pointer used as parater in `idata_init`.
 * The function should be able to hash each input interface name to
 * a unique uint64_t. That is because the hashmap currently does not
 * support pointer to arbitrary types as keys. So we have to provide
 * a unique mapping between interface_name and uint64_t.
 */
typedef uint64_t (*interfaces_hash_t)(const char *key_string, size_t len);

typedef struct idata_t *idata_handle_t;

idata_handle_t idata_init(
    const astarte_interface_t *interfaces[], size_t interfaces_len, interfaces_hash_t hash_fn);

// get an interface object of the specified interface name
// the interfaces map got initialized in `idata_init`
const astarte_interface_t *idata_get_interface(
    idata_handle_t idata, const char *interface_name, size_t len);

// add an expected message to the specified interface
int idata_add_individual(idata_handle_t idata, const astarte_interface_t *interface,
    idata_individual_t expected_individual);
int idata_add_property(
    idata_handle_t idata, const astarte_interface_t *interface, idata_property_t expected_property);
int idata_add_object(
    idata_handle_t idata, const astarte_interface_t *interface, idata_object_t expected_object);

// get current count of elements
size_t idata_get_count(idata_handle_t idata, const astarte_interface_t *interface);

// pop next element expected for the specified interface (if set the return needs to be freed)
int idata_pop_individual(
    idata_handle_t idata, const astarte_interface_t *interface, idata_individual_t *out_individual);
int idata_pop_property(
    idata_handle_t idata, const astarte_interface_t *interface, idata_property_t *out_property);
int idata_pop_object(
    idata_handle_t idata, const astarte_interface_t *interface, idata_object_t *out_object);

int idata_peek_individual(idata_handle_t idata, const astarte_interface_t *interface,
    idata_individual_t **out_individual_ref);
int idata_peek_property(idata_handle_t idata, const astarte_interface_t *interface,
    idata_property_t **out_property_ref);
int idata_peek_object(
    idata_handle_t idata, const astarte_interface_t *interface, idata_object_t **out_object_ref);

// after popping items you need to free the element (you will get ownership of the popped element)
void free_individual(idata_individual_t individual);
void free_object(idata_object_t object);
void free_property(idata_property_t property);

void idata_free(idata_handle_t idata);

void utils_log_e2e_individual(idata_individual_t *individual);
void utils_log_e2e_object(idata_object_t *object);
void utils_log_e2e_property(idata_property_t *property);

#endif // IDATA_H
```

## include/runner.h
```c
/*
 * (C) Copyright 2024, SECO Mind Srl
 *
 * SPDX-License-Identifier: Apache-2.0
 */

#ifndef E2ERUNNER_H
#define E2ERUNNER_H

// run the e2e test on all test devices
// must be called only once, it takes ownership of a semaphore so it will block until the first call
// exits
void run_e2e_test();

#endif /* E2ERUNNER_H */
```

## include/shell_handlers.h
```c
/*
 * (C) Copyright 2025, SECO Mind Srl
 *
 * SPDX-License-Identifier: Apache-2.0
 */

#ifndef E2ESHELL_HANDLERS_H
#define E2ESHELL_HANDLERS_H

/**
 * @file shell_handlers.h
 * @brief Contains the functions called by the zephyr shell
 *
 * @details This file contains the callback used by the shell zephyr library.
 * For more info take a look at https://docs.zephyrproject.org/latest/services/shell/index.html.
 */

#include <zephyr/shell/shell.h>

#include <astarte_device_sdk/device.h>

#include "idata.h"

// NOTE should be called before everything else
void init_shell(astarte_device_handle_t device, idata_handle_t idata);

int cmd_expect_object_handler(const struct shell *shell, size_t argc, char **argv);
int cmd_expect_individual_handler(const struct shell *shell, size_t argc, char **argv);
int cmd_expect_property_set_handler(const struct shell *shell, size_t argc, char **argv);
int cmd_expect_property_unset_handler(const struct shell *shell, size_t argc, char **argv);

int cmd_send_individual_handler(const struct shell *shell, size_t argc, char **argv);
int cmd_send_object_handler(const struct shell *shell, size_t argc, char **argv);
int cmd_send_property_set_handler(const struct shell *shell, size_t argc, char **argv);
int cmd_send_property_unset_handler(const struct shell *shell, size_t argc, char **argv);

int cmd_disconnect(const struct shell *shell, size_t argc, char **argv);

#endif /* E2ESHELL_HANDLERS_H */
```

## include/utilities.h
```c
/*
 * (C) Copyright 2024, SECO Mind Srl
 *
 * SPDX-License-Identifier: Apache-2.0
 */

#ifndef E2EUTILITIES_H
#define E2EUTILITIES_H

#include <stdint.h>

#include <zephyr/fatal.h>
#include <zephyr/shell/shell.h>

#include <astarte_device_sdk/data.h>
#include <astarte_device_sdk/interface.h>
#include <astarte_device_sdk/object.h>
#include <astarte_device_sdk/util.h>

/**
 * @file e2eutilities.h
 * @brief Utilities needed in e2e tests
 */

#define CHECK_HALT(expr, ...)                                                                      \
    if (expr) {                                                                                    \
        LOG_ERR(__VA_ARGS__); /* NOLINT */                                                         \
        k_fatal_halt(-1);                                                                          \
    }

#define CHECK_ASTARTE_OK_HALT(expr, ...) CHECK_HALT(expr != ASTARTE_RESULT_OK, __VA_ARGS__)

#define CHECK_RET_1(expr, ...)                                                                     \
    if (expr) {                                                                                    \
        __VA_OPT__(LOG_ERR(__VA_ARGS__)); /* NOLINT */                                             \
        return 1;                                                                                  \
    }

#define CHECK_ASTARTE_OK_RET_1(expr, ...) CHECK_RET_1(expr != ASTARTE_RESULT_OK, __VA_ARGS__)

#define CHECK_GOTO(expr, label, ...)                                                               \
    if (expr) {                                                                                    \
        LOG_ERR(__VA_ARGS__); /* NOLINT */                                                         \
        goto label;                                                                                \
    }

#define CHECK_ASTARTE_OK_GOTO(expr, label, ...)                                                    \
    CHECK_GOTO(expr != ASTARTE_RESULT_OK, label, __VA_ARGS__)

// Timestamp option used to store a valid timestamp value and its presence
typedef struct
{
    int64_t value;
    bool present;
} idata_timestamp_option_t;

ASTARTE_UTIL_DEFINE_ARRAY(idata_byte_array, uint8_t);

ASTARTE_UTIL_DEFINE_ARRAY(idata_object_entry_array, astarte_object_entry_t);

void utils_log_timestamp(idata_timestamp_option_t *timestamp);
void utils_log_object_entry_array(idata_object_entry_array *obj);

bool astarte_object_equal(idata_object_entry_array *left, idata_object_entry_array *right);
bool astarte_data_equal(astarte_data_t *left, astarte_data_t *right);

// should be called at the start of the application to avoid user input before
// the shell is actually ready and the device connected
void block_shell_commands();
// lifts the block on the shell commands
void unblock_shell_commands();

#endif /* E2EUTILITIES_H */
```

## src/device_handler.c
```c
/*
 * (C) Copyright 2025, SECO Mind Srl
 *
 * SPDX-License-Identifier: Apache-2.0
 */

#include "device_handler.h"

#include <zephyr/logging/log.h>
#include <zephyr/sys/atomic.h>

#include "astarte_device_sdk/device.h"
#include "utilities.h"
#include "utils.h"
#include "zephyr/kernel.h"

#define MAIN_THREAD_SLEEP_MS 500

enum e2e_thread_flags
{
    DEVICE_CONNECTED = 0,
    THREAD_TERMINATION,
};

K_THREAD_STACK_DEFINE(device_thread_stack_area, CONFIG_DEVICE_THREAD_STACK_SIZE);
static struct k_thread device_thread_data;

static astarte_device_handle_t device_handle;
K_SEM_DEFINE(device_sem, 1, 1);

static atomic_t device_thread_flags;

LOG_MODULE_REGISTER(device_handler, CONFIG_DEVICE_HANDLER_LOG_LEVEL); // NOLINT

static bool get_termination();
static void connection_callback(astarte_device_connection_event_t event);
static void disconnection_callback(astarte_device_disconnection_event_t event);
// write flag DEVICE_CONNECTED
static void set_connected();
static void set_disconnected();
// --
static void device_thread_entry_point(void *unused1, void *unused2, void *unused3);

void device_setup(astarte_device_config_t config)
{
    // override with local callbacks
    config.connection_cbk = connection_callback;
    config.disconnection_cbk = disconnection_callback;

    astarte_device_handle_t temp_handle = NULL;
    CHECK_HALT(k_sem_count_get(&device_sem) == 0, "The device is already initialized");

    LOG_INF("Creating static astarte_device by calling astarte_device_new."); // NOLINT
    CHECK_ASTARTE_OK_HALT(
        astarte_device_new(&config, &temp_handle), "Astarte device creation failure.");

    // we take the semaphore after initializing the device to make sure that errors from
    // astarte_device_new can be handled separately
    CHECK_HALT(k_sem_take(&device_sem, K_NO_WAIT) != 0,
        "Could not take the semaphore, the device is already initialized");
    device_handle = temp_handle;

    LOG_INF("Spawning a new thread to poll data from the Astarte device."); // NOLINT
    k_thread_create(&device_thread_data, device_thread_stack_area,
        K_THREAD_STACK_SIZEOF(device_thread_stack_area), device_thread_entry_point, NULL, NULL,
        NULL, CONFIG_DEVICE_THREAD_PRIORITY, 0, K_NO_WAIT);
}

astarte_device_handle_t get_device()
{
    CHECK_HALT(k_sem_count_get(&device_sem) > 0 || get_termination(),
        "The device is not initialized or is terminating");

    return device_handle;
}

void set_termination()
{
    atomic_set_bit(&device_thread_flags, THREAD_TERMINATION);
}

void wait_for_connection()
{
    while (!atomic_test_bit(&device_thread_flags, DEVICE_CONNECTED)) {
        k_sleep(K_MSEC(MAIN_THREAD_SLEEP_MS));
    }
}

void wait_for_disconnection()
{
    while (atomic_test_bit(&device_thread_flags, DEVICE_CONNECTED)) {
        k_sleep(K_MSEC(MAIN_THREAD_SLEEP_MS));
    }
}

void free_device()
{
    set_termination();

    CHECK_HALT(k_thread_join(&device_thread_data, K_FOREVER) != 0,
        "Failed in waiting for the Astarte thread to terminate.");

    LOG_INF("Destroing Astarte device and freeing resources."); // NOLINT
    CHECK_ASTARTE_OK_HALT(
        astarte_device_destroy(device_handle), "Astarte device destruction failure.");

    LOG_INF("Astarte device destroyed."); // NOLINT

    LOG_INF("Giving back the semaphore lock"); // NOLINT
    // allow creating another device with `device_setup`
    device_handle = NULL;
    k_sem_give(&device_sem);
}

static bool get_termination()
{
    return atomic_test_bit(&device_thread_flags, THREAD_TERMINATION);
}

static void set_connected()
{
    atomic_set_bit(&device_thread_flags, DEVICE_CONNECTED);
}

static void set_disconnected()
{
    atomic_clear_bit(&device_thread_flags, DEVICE_CONNECTED);
}

static void connection_callback(astarte_device_connection_event_t event)
{
    (void) event;
    LOG_INF("Astarte device connected"); // NOLINT
    set_connected();
}

static void disconnection_callback(astarte_device_disconnection_event_t event)
{
    (void) event;
    LOG_INF("Astarte device disconnected"); // NOLINT
    set_disconnected();
}

static void device_thread_entry_point(void *unused1, void *unused2, void *unused3)
{
    ARG_UNUSED(unused1);
    ARG_UNUSED(unused2);
    ARG_UNUSED(unused3);

    LOG_INF("Starting e2e device thread."); // NOLINT

    CHECK_ASTARTE_OK_HALT(
        astarte_device_connect(device_handle), "Astarte device connection failure.");

    while (!get_termination()) {
        k_timepoint_t timepoint = sys_timepoint_calc(K_MSEC(CONFIG_DEVICE_POLL_PERIOD_MS));

        astarte_result_t res = astarte_device_poll(device_handle);
        CHECK_HALT(res != ASTARTE_RESULT_TIMEOUT && res != ASTARTE_RESULT_OK,
            "Astarte device poll failure.");

        k_sleep(sys_timepoint_timeout(timepoint));
    }

    CHECK_ASTARTE_OK_HALT(astarte_device_disconnect(device_handle, K_SECONDS(10)),
        "Astarte device disconnection failure.");

    LOG_INF("Exiting from the polling thread."); // NOLINT
}
```

## src/idata.c
```c
/*
 * (C) Copyright 2024, SECO Mind Srl
 *
 * SPDX-License-Identifier: Apache-2.0
 */

#include "idata.h"

#include <stdint.h>
#include <stdlib.h>
#include <string.h>

#include <zephyr/logging/log.h>
#include <zephyr/sys/dlist.h>
#include <zephyr/sys/hash_map.h>
#include <zephyr/sys/hash_map_api.h>
#include <zephyr/sys/spsc_lockfree.h>
#include <zephyr/sys/util.h>
#include <zephyr/toolchain.h>

#include <astarte_device_sdk/interface.h>
#include <data_private.h>
#include <log.h>
#include <object_private.h>
#include <utils.h>

#include "utilities.h"

/************************************************
 * Constants, static variables and defines
 ***********************************************/

struct idata_t
{
    struct sys_hashmap iface_map;
    interfaces_hash_t hash_fn;
};

LOG_MODULE_REGISTER(idata, CONFIG_IDATA_LOG_LEVEL); // NOLINT

#define CHECK_INDIVIDUAL_DS(aggregation, type)                                                     \
    CHECK_RET_1((aggregation) != ASTARTE_INTERFACE_AGGREGATION_INDIVIDUAL,                         \
        "Incorrect aggregation type in interface passed expected individual datastream");          \
    CHECK_RET_1((type) != ASTARTE_INTERFACE_TYPE_DATASTREAM,                                       \
        "Incorrect interface type in interface passed expected individual datastream");

#define CHECK_AGGREGATE_DS(aggregation, type)                                                      \
    CHECK_RET_1((aggregation) != ASTARTE_INTERFACE_AGGREGATION_OBJECT,                             \
        "Incorrect aggregation type in interface passed expected aggregate datastream");           \
    CHECK_RET_1((type) != ASTARTE_INTERFACE_TYPE_DATASTREAM,                                       \
        "Incorrect interface type in interface passed expected aggregate datastream");

#define CHECK_INDIVIDUAL_PROP(aggregation, type)                                                   \
    CHECK_RET_1((aggregation) != ASTARTE_INTERFACE_AGGREGATION_INDIVIDUAL,                         \
        "Incorrect aggregation type in interface passed expected individual property");            \
    CHECK_RET_1((type) != ASTARTE_INTERFACE_TYPE_PROPERTIES,                                       \
        "Incorrect interface type in interface passed expected individual property");

/************************************************
 * Static functions declaration
 ***********************************************/

static uint64_t idata_hash_intf(interfaces_hash_t hash_fn, const astarte_interface_t *interface);
static uint64_t idata_hash_name(interfaces_hash_t hash_fn, const char *interface_name, size_t len);

static bool map_get_intf(
    idata_handle_t idata, const astarte_interface_t *interface, idata_map_value_t **value);
static bool map_get_name(
    idata_handle_t idata, const char *interface_name, size_t len, idata_map_value_t **out_value);

static void free_map_entry_callback(uint64_t key, uint64_t value, void *user_data);

/************************************************
 * Global functions definition
 ***********************************************/
idata_handle_t idata_init(
    const astarte_interface_t *interfaces[], size_t interfaces_len, const interfaces_hash_t hash_fn)
{
    struct sys_hashmap_config *hashmap_config = malloc(sizeof(struct sys_hashmap_config));
    CHECK_HALT(!hashmap_config, "Could not allocate map required memory");
    *hashmap_config
        = (struct sys_hashmap_config) SYS_HASHMAP_CONFIG(SIZE_MAX, SYS_HASHMAP_DEFAULT_LOAD_FACTOR);

    struct sys_hashmap_data *hashmap_data = calloc(1, sizeof(struct sys_hashmap_data));
    CHECK_HALT(!hashmap_data, "Could not allocate map required memory");

    struct sys_hashmap interface_map = (struct sys_hashmap) {
        .api = &sys_hashmap_sc_api,
        .config = (const struct sys_hashmap_config *) hashmap_config,
        .data = hashmap_data,
        .hash_func = sys_hash32,
        .alloc_func = SYS_HASHMAP_DEFAULT_ALLOCATOR,
    };

    for (size_t i = 0; i < interfaces_len; ++i) {
        uint64_t key = idata_hash_intf(hash_fn, interfaces[i]);
        idata_map_value_t *allocated_value = malloc(sizeof(idata_map_value_t));
        idata_map_value_t initialized_value = (idata_map_value_t) {
            .interface = interfaces[i],
            // NOTE the parameters of SPSC_INITIALIZER needs to point to allocated_value
            // since that will be the final memory location
            .messages = SPSC_INITIALIZER(
                ARRAY_SIZE(allocated_value->messages_buf), allocated_value->messages_buf),
            .messages_buf = { {} },
        };
        memcpy(allocated_value, &initialized_value, sizeof(initialized_value));

        sys_hashmap_insert(&interface_map, key, POINTER_TO_UINT(allocated_value), NULL);
    }

    struct idata_t *const idata = malloc(sizeof(struct idata_t));
    *idata = (struct idata_t) {
        .iface_map = interface_map,
        .hash_fn = hash_fn,
    };

    return idata;
}

const astarte_interface_t *idata_get_interface(
    idata_handle_t idata, const char *interface_name, size_t len)
{
    idata_map_value_t *map_value = NULL;

    if (map_get_name(idata, interface_name, len, &map_value)) {
        return map_value->interface;
    }

    return NULL;
}

int idata_add_individual(idata_handle_t idata, const astarte_interface_t *interface,
    idata_individual_t expected_individual)
{
    CHECK_INDIVIDUAL_DS(interface->aggregation, interface->type);

    idata_map_value_t *value = {};
    CHECK_RET_1(!map_get_intf(idata, interface, &value), "Unknown passed interface");

    idata_message_t *message = spsc_acquire(&value->messages);
    CHECK_RET_1(message == NULL, "Space for expected messages is exhausted");
    message->individual = expected_individual;
    spsc_produce(&value->messages);

    return 0;
}

int idata_add_property(
    idata_handle_t idata, const astarte_interface_t *interface, idata_property_t expected_property)
{
    CHECK_INDIVIDUAL_PROP(interface->aggregation, interface->type);

    idata_map_value_t *value = {};
    CHECK_RET_1(!map_get_intf(idata, interface, &value), "Unknown passed interface");

    idata_message_t *message = spsc_acquire(&value->messages);
    CHECK_RET_1(message == NULL, "Space for expected messages is exhausted");
    message->property = expected_property;
    spsc_produce(&value->messages);

    return 0;
}

int idata_add_object(
    idata_handle_t idata, const astarte_interface_t *interface, idata_object_t expected_object)
{
    CHECK_AGGREGATE_DS(interface->aggregation, interface->type);

    idata_map_value_t *value = {};
    CHECK_RET_1(!map_get_intf(idata, interface, &value), "Unknown passed interface");

    idata_message_t *message = spsc_acquire(&value->messages);
    CHECK_RET_1(message == NULL, "Space for expected messages is exhausted");
    message->object = expected_object;
    spsc_produce(&value->messages);

    return 0;
}

size_t idata_get_count(idata_handle_t idata, const astarte_interface_t *interface)
{
    idata_map_value_t *value = {};
    CHECK_RET_1(!map_get_intf(idata, interface, &value), "Unknown passed interface");

    return spsc_consumable(&value->messages);
}

int idata_pop_individual(
    idata_handle_t idata, const astarte_interface_t *interface, idata_individual_t *out_individual)
{
    CHECK_RET_1(out_individual == NULL, "Passed out pointer is null");
    CHECK_INDIVIDUAL_DS(interface->aggregation, interface->type);

    idata_map_value_t *value = {};
    CHECK_RET_1(!map_get_intf(idata, interface, &value), "Unknown passed interface");
    idata_message_t *message = spsc_consume(&value->messages);
    CHECK_RET_1(message == NULL, "No more expected messages");
    *out_individual = message->individual;
    spsc_release(&value->messages);

    return 0;
}

int idata_pop_property(
    idata_handle_t idata, const astarte_interface_t *interface, idata_property_t *out_property)
{
    CHECK_RET_1(out_property == NULL, "Passed out pointer is null");
    CHECK_INDIVIDUAL_PROP(interface->aggregation, interface->type);

    idata_map_value_t *value = {};
    CHECK_RET_1(!map_get_intf(idata, interface, &value), "Unknown passed interface");
    idata_message_t *message = spsc_consume(&value->messages);
    CHECK_RET_1(message == NULL, "No more expected messages");
    *out_property = message->property;
    spsc_release(&value->messages);

    return 0;
}

int idata_pop_object(
    idata_handle_t idata, const astarte_interface_t *interface, idata_object_t *out_object)
{
    CHECK_RET_1(out_object == NULL, "Passed out pointer is null");
    CHECK_AGGREGATE_DS(interface->aggregation, interface->type);

    idata_map_value_t *value = {};
    CHECK_RET_1(!map_get_intf(idata, interface, &value), "Unknown passed interface");
    idata_message_t *message = spsc_consume(&value->messages);
    CHECK_RET_1(message == NULL, "No more expected messages");
    *out_object = message->object;
    spsc_release(&value->messages);

    return 0;
}

int idata_peek_individual(idata_handle_t idata, const astarte_interface_t *interface,
    idata_individual_t **out_individual_ref)
{
    CHECK_INDIVIDUAL_DS(interface->aggregation, interface->type);

    idata_map_value_t *value = {};
    CHECK_RET_1(!map_get_intf(idata, interface, &value), "Unknown passed interface");
    idata_message_t *message = spsc_peek(&value->messages);
    CHECK_RET_1(!message);

    if (out_individual_ref) {
        *out_individual_ref = &message->individual;
    }

    return 0;
}
int idata_peek_property(
    idata_handle_t idata, const astarte_interface_t *interface, idata_property_t **out_property_ref)
{
    CHECK_INDIVIDUAL_PROP(interface->aggregation, interface->type);

    idata_map_value_t *value = {};
    CHECK_RET_1(!map_get_intf(idata, interface, &value), "Unknown passed interface");
    idata_message_t *message = spsc_peek(&value->messages);
    CHECK_RET_1(!message);

    if (out_property_ref) {
        *out_property_ref = &message->property;
    }

    return 0;
}

int idata_peek_object(
    idata_handle_t idata, const astarte_interface_t *interface, idata_object_t **out_object_ref)
{
    CHECK_AGGREGATE_DS(interface->aggregation, interface->type);

    idata_map_value_t *value = {};
    CHECK_RET_1(!map_get_intf(idata, interface, &value), "Unknown passed interface");
    idata_message_t *message = spsc_peek(&value->messages);
    CHECK_RET_1(!message);

    if (out_object_ref) {
        *out_object_ref = &message->object;
    }

    return 0;
}

void free_individual(idata_individual_t individual)
{
    free((char *) individual.path);
    astarte_data_destroy_deserialized(individual.data);
}

void free_object(idata_object_t object)
{
    free((char *) object.path);
    free(object.object_bytes.buf);
    astarte_object_entries_destroy_deserialized(object.entries.buf, object.entries.len);
}

void free_property(idata_property_t property)
{
    // unsets do not store an individual value
    if (!property.unset) {
        astarte_data_destroy_deserialized(property.data);
    }

    free((char *) property.path);
}

void idata_free(idata_handle_t idata)
{
    sys_hashmap_clear(&idata->iface_map, free_map_entry_callback, idata);

    free((void *) idata->iface_map.config);
    free(idata->iface_map.data);

    free(idata);
}

void utils_log_e2e_individual(idata_individual_t *individual)
{
    LOG_INF("Individual path: %s", individual->path);
    utils_log_timestamp(&individual->timestamp);
    utils_log_astarte_data(individual->data);
}

void utils_log_e2e_object(idata_object_t *object)
{
    LOG_INF("Object path: %s", object->path);
    utils_log_timestamp(&object->timestamp);
    utils_log_object_entry_array(&object->entries);
}

void utils_log_e2e_property(idata_property_t *property)
{
    LOG_INF("Property path: %s", property->path);
    if (property->unset) {
        LOG_INF("Property Unset");
    } else {
        utils_log_astarte_data(property->data);
    }
}

/************************************************
 * Static functions definitions
 ***********************************************/

static void free_map_entry_callback(uint64_t key, uint64_t value, void *user_data)
{
    ARG_UNUSED(key);
    idata_handle_t idata = user_data;

    // NOLINTNEXTLINE
    idata_map_value_t *data_value = UINT_TO_POINTER(value);

    if (data_value->interface->type == ASTARTE_INTERFACE_TYPE_PROPERTIES) {
        idata_property_t property = {};
        while (idata_pop_property(idata, data_value->interface, &property) == 0) {
            free_property(property);
        }
    } else if (data_value->interface->aggregation == ASTARTE_INTERFACE_AGGREGATION_OBJECT) {
        idata_object_t object = {};
        while (idata_pop_object(idata, data_value->interface, &object) == 0) {
            free_object(object);
        }
    } else if (data_value->interface->aggregation == ASTARTE_INTERFACE_AGGREGATION_INDIVIDUAL) {
        idata_individual_t individual = {};
        while (idata_pop_individual(idata, data_value->interface, &individual) == 0) {
            free_individual(individual);
        }
    }
}

static uint64_t idata_hash_intf(interfaces_hash_t hash_fn, const astarte_interface_t *interface)
{
    return idata_hash_name(hash_fn, interface->name, strlen(interface->name));
}

static uint64_t idata_hash_name(interfaces_hash_t hash_fn, const char *interface_name, size_t len)
{
    return hash_fn(interface_name, len);
}

static bool map_get_intf(
    idata_handle_t idata, const astarte_interface_t *interface, idata_map_value_t **out_value)
{
    return map_get_name(idata, interface->name, strlen(interface->name), out_value);
}

static bool map_get_name(
    idata_handle_t idata, const char *interface_name, size_t len, idata_map_value_t **out_value)
{
    uint64_t key = idata_hash_name(idata->hash_fn, interface_name, len);
    uint64_t value = { 0 };

    if (!sys_hashmap_get(&idata->iface_map, key, &value)) {
        return false;
    }

    // NOLINTNEXTLINE
    *out_value = UINT_TO_POINTER(value);

    return true;
}
```

## src/utilities.c
```c
/*
 * (C) Copyright 2024, SECO Mind Srl
 *
 * SPDX-License-Identifier: Apache-2.0
 */

#include "utilities.h"

#include <stdint.h>
#include <stdlib.h>
#include <string.h>

#include <zephyr/fatal.h>
#include <zephyr/logging/log.h>
#include <zephyr/shell/shell_uart.h>
#include <zephyr/sys/bitarray.h>
#include <zephyr/sys/timeutil.h>
#include <zephyr/sys/util.h>

#include <astarte_device_sdk/data.h>
#include <astarte_device_sdk/interface.h>
#include <astarte_device_sdk/mapping.h>
#include <astarte_device_sdk/object.h>
#include <astarte_device_sdk/result.h>

#include "log.h"
#include "utils.h"

/************************************************
 * Constants, static variables and defines
 ***********************************************/

LOG_MODULE_REGISTER(utilities, CONFIG_UTILITIES_LOG_LEVEL); // NOLINT

#define CMP_ARRAY(LEFT, RIGHT, TYPE_SIZE)                                                          \
    if ((LEFT).len != (RIGHT).len) {                                                               \
        return false;                                                                              \
    }                                                                                              \
    return memcmp((LEFT).buf, (RIGHT).buf, (LEFT).len * (TYPE_SIZE)) == 0;

#define CMP_ARRAY_SIZED(LEFT, RIGHT) CMP_ARRAY(LEFT, RIGHT, sizeof((LEFT).buf[0]))

// The limit of interface mappings and following of object entries is 1024
// https://docs.astarte-platform.org/astarte/latest/040-interface_schema.html#interface
#define OBJECT_MAX_ENTRIES 1024

#define MAX_TS_STR_LEN 30

/************************************************
 *         Static functions declaration         *
 ***********************************************/

static bool cmp_string_array(astarte_data_stringarray_t *left, astarte_data_stringarray_t *right);
static bool cmp_binaryblob_array(
    astarte_data_binaryblobarray_t *left, astarte_data_binaryblobarray_t *right);
static astarte_data_t *get_object_entry_data(idata_object_entry_array *entries, const char *key);
// shell bypass callback
static void shell_bypass_halt(const struct shell *shell, uint8_t *data, size_t len);

/************************************************
 * Global functions definition
 ***********************************************/

bool astarte_object_equal(idata_object_entry_array *left, idata_object_entry_array *right)
{
    if (left->len != right->len) {
        return false;
    }

    if (left->len > OBJECT_MAX_ENTRIES) {
        ASTARTE_LOG_ERR("Number of entries of the two object (%zu) exceeds the limit imposed by "
                        "astarte protocol",
            left->len);
        return false;
    }

    if (left->len == 0) {
        return true;
    }

    SYS_BITARRAY_DEFINE(accessed_entries, OBJECT_MAX_ENTRIES);
    size_t accessed_entries_offset = { 0 };
    int bita_alloc_res = sys_bitarray_alloc(&accessed_entries, left->len, &accessed_entries_offset);

    switch (bita_alloc_res) {
        case -EINVAL:
            ASTARTE_LOG_ERR("Allocating invalid number of bits");
            return false;
        case -ENOSPC:
            ASTARTE_LOG_ERR("No space for bitarray");
            return false;
        default:
            ASTARTE_LOG_ERR("Unexpected bitarray allocation return code");
            return false;
        case 0:
            break;
    }

    sys_bitarray_clear_region(&accessed_entries, left->len, accessed_entries_offset);
    bool result = true;

    for (size_t i = 0; i < left->len; ++i) {
        const char *left_key = left->buf[i].path;
        astarte_data_t *left_value = &left->buf[i].data;

        astarte_data_t *right_value = get_object_entry_data(right, left_key);
        // check that the value exist in the right object
        if (!right_value) {
            result = false;
            goto exit;
        }

        astarte_object_entry_t *right_value_entry
            = CONTAINER_OF(right_value, astarte_object_entry_t, data);
        // assert that the right entry hasn't already been checked (no duplicate in left)
        size_t offset = right_value_entry - right->buf;
        int previous_value = { 0 };
        sys_bitarray_test_and_set_bit(&accessed_entries, offset, &previous_value);
        if (previous_value == 1) {
            result = false;
            goto exit;
        }

        // check that the value is equal in the right object
        if (!astarte_data_equal(left_value, right_value)) {
            result = false;
            goto exit;
        }
    }

exit:
    sys_bitarray_free(&accessed_entries, left->len, accessed_entries_offset);
    return result;
}

bool astarte_data_equal(astarte_data_t *left, astarte_data_t *right)
{
    if (left->tag != right->tag) {
        return false;
    }

    switch (left->tag) {
        case ASTARTE_MAPPING_TYPE_BOOLEAN:
            return left->data.boolean == right->data.boolean;
        case ASTARTE_MAPPING_TYPE_DATETIME:
            return left->data.datetime == right->data.datetime;
        case ASTARTE_MAPPING_TYPE_DOUBLE:
            return left->data.dbl == right->data.dbl;
        case ASTARTE_MAPPING_TYPE_INTEGER:
            return left->data.integer == right->data.integer;
        case ASTARTE_MAPPING_TYPE_LONGINTEGER:
            return left->data.longinteger == right->data.longinteger;
        case ASTARTE_MAPPING_TYPE_STRING:
            return strcmp(left->data.string, right->data.string) == 0;
        case ASTARTE_MAPPING_TYPE_BINARYBLOB:
            CMP_ARRAY(left->data.binaryblob, right->data.binaryblob, sizeof(uint8_t))
        case ASTARTE_MAPPING_TYPE_BOOLEANARRAY:
            CMP_ARRAY_SIZED(left->data.boolean_array, right->data.boolean_array)
        case ASTARTE_MAPPING_TYPE_DATETIMEARRAY:
            CMP_ARRAY_SIZED(left->data.datetime_array, right->data.datetime_array)
        case ASTARTE_MAPPING_TYPE_DOUBLEARRAY:
            CMP_ARRAY_SIZED(left->data.double_array, right->data.double_array)
        case ASTARTE_MAPPING_TYPE_INTEGERARRAY:
            CMP_ARRAY_SIZED(left->data.integer_array, right->data.integer_array)
        case ASTARTE_MAPPING_TYPE_LONGINTEGERARRAY:
            CMP_ARRAY_SIZED(left->data.longinteger_array, right->data.longinteger_array)
        case ASTARTE_MAPPING_TYPE_STRINGARRAY:
            return cmp_string_array(&left->data.string_array, &right->data.string_array);
        case ASTARTE_MAPPING_TYPE_BINARYBLOBARRAY:
            return cmp_binaryblob_array(
                &left->data.binaryblob_array, &right->data.binaryblob_array);
        default:
            // something bad happened
            CHECK_HALT(true, "Unsupported mapping type");
    }

    CHECK_HALT(true, "Unreachable, the previous switch should handle all possible cases");
}

void utils_log_timestamp(idata_timestamp_option_t *timestamp)
{
    char tm_str[DATETIME_MAX_BUF_LEN] = { 0 };
    if (timestamp->present) {
        __ASSERT(utils_datetime_to_string(timestamp->value, tm_str) != 0,
            "Buffer size for datetime conversion too small");
        LOG_INF("Timestamp: %s", tm_str); // NOLINT
    } else {
        LOG_INF("No timestamp"); // NOLINT
    }
}

void utils_log_object_entry_array(idata_object_entry_array *obj)
{
    utils_log_astarte_object(obj->buf, obj->len);
}

void block_shell_commands()
{
    // Bypass shell commands until the e2e code re-enables them
    const struct shell *uart_shell = shell_backend_uart_get_ptr();
    shell_set_bypass(uart_shell, shell_bypass_halt);
}

void unblock_shell_commands()
{
    // remove bypass to allow shell callbacks to be called
    const struct shell *uart_shell = shell_backend_uart_get_ptr();
    shell_set_bypass(uart_shell, NULL);
}

/************************************************
 *         Static functions definitions         *
 ***********************************************/

static bool cmp_string_array(astarte_data_stringarray_t *left, astarte_data_stringarray_t *right)
{
    if (left->len != right->len) {
        return false;
    }

    for (int i = 0; i < left->len; ++i) {
        if (strcmp(left->buf[i], right->buf[i]) != 0) {
            return false;
        }
    }

    return true;
}

static bool cmp_binaryblob_array(
    astarte_data_binaryblobarray_t *left, astarte_data_binaryblobarray_t *right)
{
    if (left->count != right->count) {
        return false;
    }

    for (int i = 0; i < left->count; ++i) {
        if (left->sizes[i] != right->sizes[i]) {
            return false;
        }
        if (memcmp(left->blobs[i], right->blobs[i], left->sizes[i]) != 0) {
            return false;
        }
    }

    return true;
}

static astarte_data_t *get_object_entry_data(idata_object_entry_array *entries, const char *key)
{
    for (size_t i = 0; i < entries->len; ++i) {
        if (strcmp(key, entries->buf[i].path) == 0) {
            return &entries->buf[i].data;
        }
    }

    return NULL;
}

static void shell_bypass_halt(const struct shell *shell, uint8_t *data, size_t len)
{
    ARG_UNUSED(shell);

    CHECK_HALT(len > 0 || data[0] != 10, "Shell commands are being ignored blocking execution");
}
```
